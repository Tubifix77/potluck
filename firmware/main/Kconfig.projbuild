## firmware/main/Kconfig.projbuild
```kconfig
menu "Potluck M0"

config POT_NODE_ID
    int "Node id (0 = derive from the low two bytes of the station MAC)"
    range 0 65534
    default 0
    help
        Potluck Frame node id, ARCHITECTURE.md section 5.1. 0x0000 means unprovisioned and 0xFFFF is
        broadcast, so neither is selectable here.

        Leaving this at 0 derives the id from the board's own MAC, which means the same binary can
        be flashed to both M0 boards and they will still have distinct ids. That is deliberate: a
        soak that requires two different builds is a soak where the two boards can differ in ways
        nobody intended.

config POT_CHANNEL
    int "Wi-Fi channel"
    range 1 14
    default 1
    help
        Every node must be on the same channel: ESP-IDF requires a peer's channel to match the
        channel the local device is on.

config POT_HB_PERIOD_MS
    int "Heartbeat period in milliseconds"
    range 20 5000
    default 100
    help
        ARCHITECTURE.md section 8.2 fixes this at 100 ms for ESP-NOW, with death declared after 6
        misses (600 ms). Section 8.2 also shows that any wireless liveness timeout below ~150 ms
        is provably wrong, so shortening the derived death window below that is a measurement of
        false disconnects rather than of the link.

config POT_HB_MISS_LIMIT
    int "Heartbeat misses before a peer is declared dead"
    range 2 60
    default 6

config POT_BEACON_UNICAST
    bool "Carry liveness by unicast full mesh (O(N^2)) instead of the broadcast beacon"
    default n
    help
        ARCHITECTURE.md section 8.2 fixes the heartbeat timings but says nothing about how the
        beacon reaches its peers, and the difference decides whether a cell fits its channel.

        DEFAULT (n) - broadcast beacon + round-robin unicast probe, O(N). One broadcast beacon per
        node per period carries liveness to every peer, and RTT/PDR ride a separate round-robin
        unicast probe at their own slower interval. Section 8.2's period, miss limit and 600 ms
        death declaration are unchanged. A 20-node cell costs about 240 frames/s this way.

        SET TO y - unicast full mesh, O(N^2). A probe to every peer every period, each answered
        immediately: 2*N*(N-1) frames per period, about 7600 frames/s at 20 nodes. This is what M0
        originally shipped, and with two boards it is indistinguishable from correct. At seven nodes
        it needs about 840 frames/s, which does not fit a 1 Mbit/s channel once real PHY overhead is
        counted. Select it only to reproduce the saturation on hardware. sim/ models it too.

        WHY THIS IS A bool AND NOT A choice, WHICH IS WHAT IT WANTS TO BE: a Kconfig `choice` member
        cannot be overridden from an sdkconfig.defaults overlay - the assignment is accepted in
        silence and the default wins. Verified here on 2026-08-09: an overlay carrying
        CONFIG_POT_BEACON_UNICAST=y produced a build with CONFIG_POT_BEACON_BROADCAST=y, while a
        plain int in the same fragment applied correctly. Since the only reason to touch this knob is
        a scripted A/B measurement on the bench, a form of the knob that scripts cannot set is worse
        than useless: it would hand back broadcast numbers labelled as unicast.

config POT_PROBE_INTERVAL_MS
    int "Round-robin unicast probe interval, in milliseconds"
    range 100 60000
    default 1000
    # Deliberately NOT `depends on` the beacon mode. It used to depend on the broadcast half of a
    # Kconfig choice, which meant that in the other mode the symbol was not merely unset but
    # *undefined* — an unselected Kconfig symbol does not exist at all, it does not silently become
    # zero. In `#if` that reads as 0 and compiles; in ordinary C it is an undeclared identifier. The
    # unicast build broke on exactly that the moment the choice was flattened. A knob that is
    # meaningless in one mode is better left defined and ignored than made to vanish.
    help
        How often each node probes one peer for RTT and ACK-based PDR. This is a diagnostic rather
        than a liveness signal, so it need not be the heartbeat period: at one second a 20-node
        cell still collects over 4000 samples per link across a 24-hour soak.

config POT_STATS_INTERVAL_MS
    int "Interval between serial statistics dumps, in milliseconds"
    range 1000 600000
    default 10000

config POT_HELLO_INTERVAL_MS
    int "Interval between broadcast HELLO announcements, in milliseconds"
    range 200 60000
    default 2000
    help
        Broadcast until a peer answers, then keep announcing at this rate so that a peer which
        rebooted is rediscovered without anyone touching the boards.

config POT_BYE_BUTTON_GPIO
    int "GPIO that sends BYE and leaves the mesh while held low (-1 disables)"
    range -1 39
    default 0
    help
        GPIO0 is the BOOT button on most ESP32 development boards. Pressing it makes the node
        announce an intentional departure (opcode BYE) and stop heartbeating, which is the only
        way to exercise the difference between "left" and "dead" without unplugging a board.
        Press again to rejoin.

config POT_LONG_RANGE
    bool "Enable the ESP-NOW long-range PHY"
    default n
    help
        Off by default. ARCHITECTURE.md section 3's measurements are 802.11b/g at 1 Mbit/s, and a
        bench figure taken with a different PHY is not comparable to them.

config POT_RADIO_DISABLE
    bool "Build without the radio (emulation / serial-only bring-up)"
    default n
    help
        Skips Wi-Fi and ESP-NOW entirely. The node still boots, reads its boot epoch, declares its
        namespace and serves the frame link over UART.

        This exists because QEMU emulates the ESP32-S3's CPU, memory and UARTs but has no Wi-Fi
        device: esp_wifi_start() enters PHY calibration and never returns, so a normal build hangs
        rather than failing. It is also the right build for bringing up a serial link on a bench
        before any radio work.

        A node built this way reports "no_radio":1 on every statistics line, so no run from it can
        be mistaken for the measured soak section 13-M0 asks for.

config POT_SERIAL_LINK
    bool "Frame link to a host over UART1 (potluck-bridge)"
    default y
    help
        ARCHITECTURE.md section 7.1's potluck-bridge speaks Potluck Frames over a serial link. This is the
        node's end of it: COBS + CRC-16 framing on a UART separate from the console, so binary
        frames and human-readable logs cannot corrupt each other.

        The host appears as an ordinary peer with a reserved MAC, so membership, the namespace and
        section 4's read contract treat it exactly like a radio peer. Section 8.1 says a mode
        transition is a non-event, which only holds if a host is not a special case.

        Costs a UART, two GPIOs and about 8 KB. Turn it off for a pure Mode C node.

config POT_SERIAL_TX_GPIO
    int "Frame-link UART TX pin"
    depends on POT_SERIAL_LINK
    default 17
    help
        On the ESP32-S3-DevKitC-1 N16R8, GPIO 33-37 are consumed by the octal PSRAM even when PSRAM
        is disabled in software, so they are avoided here. 17 and 18 are free on that board.

config POT_SERIAL_RX_GPIO
    int "Frame-link UART RX pin"
    depends on POT_SERIAL_LINK
    default 18

config POT_SERIAL_BAUD
    int "Frame-link UART baud rate"
    depends on POT_SERIAL_LINK
    default 921600

config POT_FRAME_TEE
    bool "Tee every frame to the serial console as hex"
    default n
    help
        Emits one line per frame, in both directions, so host/potluck can record them in
        ARCHITECTURE.md section 7.6's capture format and replay them later.

        Off by default, and that default is a measurement decision rather than caution: at a 100 ms
        heartbeat with a probe and a reply in each direction this is roughly 40 lines per second of
        about 150 bytes, and the console UART's cost would land inside the very timing the soak is
        measuring. Turn it on to debug the wire, off to measure the link.

config POT_MEM_BENCH
    bool "M5.1 CR-5: measure internal RAM against PSRAM at boot, then run the node as usual"
    default n
    depends on SPIRAM
    help
        Prints heap totals for internal RAM and PSRAM and the copy throughput of each (internal to
        internal, PSRAM to PSRAM, PSRAM to internal), and places a 64 KB buffer in PSRAM's BSS to show
        the section 6 gate counts internal static RAM only. Build it with the psram variant.

config POT_CRYPTO_BENCH
    bool "Run the M5 signature/key-exchange benchmark instead of the node"
    default n
    help
        M5's open [MEASURE]: Ed25519 against P-256 on measured verify cost. Runs known-answer checks
        for every implementation, then times signature verify and sign, X25519 and P-256 ECDH, and an
        HMAC-SHA256 frame tag, printing one {"t":"bench"} line each, and stops. Starts no radio and no
        serial link. Unlike the self-test its figures ARE measurements -- on a board, never under QEMU.

config POT_SELFTEST
    bool "Run the on-target self-test instead of the node"
    default n
    help
        Runs the checks in main/selftest.cpp and stops, without starting the node, the radio, or the
        serial link. Everything it checks is a property of the running machine rather than of the
        source: a struct cast onto an unaligned buffer, double-precision arithmetic on a part whose
        FPU is single-precision only, a task actually landing on core 1, and the codec path's real
        stack cost. The host tests prove the same code on x86-64; nothing there can see any of this.

        It touches no peripheral, so it runs under QEMU -- which is the point, since a board is not
        required to catch a target-specific mistake. No timing figure it prints is a performance
        measurement: QEMU is not cycle-accurate.

        Use tools/run_selftest.ps1 rather than setting this by hand.

config POT_STATUS_LED_GPIO
    int "GPIO of the onboard RGB status LED (-1 disables)"
    range -1 48
    default 48
    help
        The DevKitC-1 RGB LED is a single WS2812-style pixel. Espressif moved it between board
        revisions: GPIO48 on v1.0, GPIO38 on v1.1 (the ledger has both user guides), and listings
        rarely say which revision ships. So the pin is a setting, never a literal, and the
        firmware drives this pin AND POT_STATUS_LED_GPIO_ALT. On these boards nothing else is
        attached to either, so the wrong one simply has no LED on it.

        The colour is this node's own view of the cell, for reading without a console:
          green   every peer heard, heartbeat loss under 10 % over the last two seconds
          yellow  every peer heard, but some peer losing 10-50 %
          red     some peer losing over 50 %, or declared dead
          blue    no peer has been heard since power-up
        At power-up it shows red, green, blue for half a second each, in that order. If the
        order on the board differs, the LED's byte order is not GRB and the colours above lie.

config POT_STATUS_LED_GPIO_ALT
    int "Second GPIO driven as the RGB status LED (-1 disables)"
    range -1 48
    default 38
    help
        See POT_STATUS_LED_GPIO: the other board revision's LED pin.

config POT_TRIAL_HEARTBEATS
    int "Heartbeats a newly deployed slot must send before it is confirmed (section 7.4)"
    range 10 10000
    default 100
    help
        Section 7.4 step 4 says N heartbeats, default 10. At a 100 ms heartbeat that is one second,
        which would confirm a module that fails a few seconds in. 100 heartbeats is ten seconds of
        running before a slot becomes the fallback for the next deployment.

config POT_TRIAL_MAX_BOOTS
    int "Boots a slot on trial may use before it is reverted"
    range 1 10
    default 3
    help
        A module that crashes its node is retried this many times, then the node goes back to its
        previous slot by itself.

config POT_EXTENDER
    bool "M6.1: the extender build -- poor-mans-extender's hotspot owns Wi-Fi, Potluck attaches"
    default n
    help
        Pulls in poor-mans-extender's pme_hotspot component (station on the house router, SoftAP for
        phones, NAT) and lets it own the Wi-Fi driver; ESP-NOW only attaches, never retunes or scans,
        and the node announces the router's channel to the cell. Build it with
        tools\build_firmware.ps1 -Variant extender -PmeHotspot <poor-mans-extender\firmware\components>.
        Credentials: POT! pme sta / ap / forget on the console. Without credentials the node runs as an
        ordinary member.

config POT_EXTENDER_AP_SSID_DEFAULT
    string "Hotspot name when none is saved"
    depends on POT_EXTENDER
    default "garden-extender"
    help
        The same default as poor-mans-extender's own firmware. There is no default password: the
        hotspot does not start until one is saved, so a fresh board never offers an open network.

config POT_EXTENDER_AP_MAX_CONN
    int "Maximum phones on the hotspot"
    depends on POT_EXTENDER
    range 1 10
    default 4

config POT_RECONCILER
    bool "Run portable actors: the section 7.7 reconciler (M6)"
    default y if SPIRAM
    help
        Places the deployed image's portable actors on live nodes and moves them when a node dies,
        with claims, fencing and handover (components/pot_reconcile). Its tables live in PSRAM, and
        with it on, a build without PSRAM spends internal RAM that section 6's 64 KB core cap does
        not have -- so it defaults on only where PSRAM is configured. A node built without it still
        joins the cell; it refuses an image that contains a portable actor.

config POT_REQUIRE_AUTH
    bool "Admit only peers enrolled by this cluster's CA (section 9.3, M5)"
    default y
    help
        With this on, a HELLO is admitted only if it carries a node certificate from the CA this
        board was enrolled under and an Ed25519 signature by the certified key; anything else is
        refused and logged as a peer_refused event. An unenrolled board therefore joins no cell, and
        is joined by none -- enrol it first (python -m potluck.enrol). The serial frame link to the
        host is trusted as a cable and admitted unsigned. Ignored in CAN builds, which admit peers
        by beacon and carry no authentication yet.

config POT_CAN
    bool "CAN (TWAI) transport, section 5.3.1 (M4)"
    default n
    help
        Classic CAN through the ESP32's TWAI controller and an SN65HVD230 transceiver. A beacon admits
        its sender (no HELLO on CAN), SAFE_STATE travels as one frame, everything else segments. In a
        CAN build broadcasts go to CAN only: v1 has no router to keep a node reachable on two
        transports from appearing as two peers, so M4's boards also set POT_RADIO_DISABLE.

config POT_CAN_TX_GPIO
    int "GPIO to the transceiver's TX pin (its driver input D)"
    depends on POT_CAN
    range 0 48
    default 4

config POT_CAN_RX_GPIO
    int "GPIO to the transceiver's RX pin (its receiver output R)"
    depends on POT_CAN
    range 0 48
    default 5

config POT_CAN_BITRATE
    int "CAN bit rate, bit/s"
    depends on POT_CAN
    range 10000 1000000
    default 500000

config POT_CAN_LOOPBACK
    bool "TWAI loopback self-test: hear our own frames, need no ACK, no transceiver"
    depends on POT_CAN
    default n

config POT_M4_FLOOD
    bool "M4 demonstration: saturate the bus with lowest-priority telemetry"
    depends on POT_CAN
    default n

config POT_M4_SAFE_STATE_MS
    int "M4 demonstration: send SAFE_STATE every N ms (0 = never)"
    depends on POT_CAN
    range 0 60000
    default 0

endmenu
```
